## board/ronetix/imx8mm-cm/Kconfig
```kconfig
if TARGET_IMX8MM_COMPACT_CM || TARGET_IMX8MM_COMPACT_2GB_CM

config SYS_BOARD
	default "imx8mm-cm"

config SYS_VENDOR
	default "ronetix"

config SYS_CONFIG_NAME
	default "imx8mm_compact_cm"

config IMX_CONFIG
	default "board/ronetix/imx8mm-cm/imximage-8mm-lpddr4.cfg"

endif
```

## board/ronetix/imx8mn-cm/Kconfig
```kconfig
if TARGET_IMX8MN_COMPACT_CM

config SYS_BOARD
	default "imx8mn-cm"

config SYS_VENDOR
	default "ronetix"

config SYS_CONFIG_NAME
	default "imx8mn_compact_cm"

config IMX_CONFIG
	default "board/ronetix/imx8mn-cm/imximage-8mn-lpddr4.cfg"

endif
```

## board/ronetix/imx93-osm/Kconfig
```kconfig
if TARGET_IMX93_OSM

config SYS_BOARD
	default "imx93-osm"

config SYS_VENDOR
	default "ronetix"

config SYS_CONFIG_NAME
	default "imx93_osm"

choice
	prompt "Select LPDDR4X size"
	default IMX93_OSM_LPDDR4X_1GB

config IMX93_OSM_LPDDR4X_1GB
	bool "Using LPDDR4X 1GB"
	help
	  Use LPDDR4X timing file for 1GB

config IMX93_OSM_LPDDR4X_2GB
	bool "Using LPDDR4X 2GB"
	help
	  Use LPDDR4X timing file for 2GB

endchoice

endif
```

## board/ronetix/rzv2n-smarc/Kconfig
```kconfig
if TARGET_RNX_RZV2N_SMARC

config SYS_SOC
	default "renesas"

config SYS_BOARD
	default "rzv2n-smarc"

config SYS_VENDOR
	default "ronetix"

config SYS_CONFIG_NAME
	default "rnx-rzv2n-smarc"

endif
```
