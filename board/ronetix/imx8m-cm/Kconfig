## board/ronetix/imx8m-cm/Kconfig
```kconfig
if TARGET_IMX8M_CM

config SYS_BOARD
	default "imx8m-cm"

config SYS_VENDOR
	default "ronetix"

config SYS_CONFIG_NAME
	default "imx8m-cm"

endif
```

## board/ronetix/imx8mp-cm/Kconfig
```kconfig
if TARGET_IMX8MP_CM

config SYS_BOARD
	default "imx8mp-cm"

config SYS_VENDOR
	default "ronetix"

config SYS_CONFIG_NAME
	default "imx8mp_cm"

config IMX_CONFIG
	default "board/ronetix/imx8mp-cm/imximage-8mp-lpddr4.cfg"

endif
```

## board/ronetix/rnx-rzg2ul-osm/Kconfig
```kconfig
if TARGET_RNX_RZG2UL_OSM || TARGET_RZG2UL_TYPE1_DEV || TARGET_RZG2UL_TYPE1_DDR3L_DEV || TARGET_RZG2UL_TYPE2_DEV

config SYS_SOC
	default "rmobile"

config SYS_BOARD
	default "rnx-rzg2ul-osm"

config SYS_VENDOR
	default "ronetix"

config SYS_CONFIG_NAME
	default "rnx-rzg2ul-osm"

endif
```
